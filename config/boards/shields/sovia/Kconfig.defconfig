## config/boards/shields/sovia/Kconfig.defconfig
```kconfig
# Copyright (c) 2021 The ZMK Contributors
# SPDX-License-Identifier: MIT

if SHIELD_SOVIA

config ZMK_KEYBOARD_NAME
    default "Sovia"

endif
```

## config/boards/shields/sovia/Kconfig.shield
```kconfig
# Copyright (c) 2021 The ZMK Contributors
# SPDX-License-Identifier: MIT

config SHIELD_SOVIA
    def_bool $(shields_list_contains,sovia)
```
